## CMakeLists.txt
```
cmake_minimum_required(VERSION 3.13.1)
find_package(Zephyr REQUIRED HINTS $ENV{ZEPHYR_BASE})

project(app LANGUAGES C)

zephyr_include_directories(include)

message(STATUS "Value of BUILD_TEST_APP environment variable is: ${CONFIG_BUILD_TEST_APP}")
if(NOT CONFIG_BUILD_TEST_APP EQUAL "y")
    file(GLOB APP_SOURCES "src/*.c")
    target_sources(app PRIVATE ${APP_SOURCES})
endif()
```

## Kconfig
```
config TEMPERATURE_LOGGER_BUFFER_SIZE
    int "Temperature Logger Data Point Buffer Length"
    default 576
    range 2 1024  # Set a practical range (min 2, max 1024)
    help
      Sets the maximum number of temperature data points that can be stored
      in the internal memory buffer before downsampling occurs.

      Note: This value should be an even number to ensure proper memory
      alignment and symmetry if data merging logic relies on pairs.
      (Current setting: 576 data points = 2 days @ 5 minute sampling).

config BUILD_TEST_APP
    bool "Build application for test execution"
    default n
    help
      If enabled, the main application's entry point (main.c) is excluded
      and replaced by a test suite runner's main() function.
```

## west.yml
```
# Copyright (c) 2021 Nordic Semiconductor ASA
# SPDX-License-Identifier: Apache-2.0

manifest:

  self:
    path: app

  remotes:
    - name: zephyrproject-rtos
      url-base: https://github.com/zephyrproject-rtos

  projects:
    - name: zephyr
      remote: zephyrproject-rtos
      revision: v4.2.0
      import:
        name-allowlist:
          - hal_espressif
          - mcuboot
          - mbedtls
```

## prj.conf
```kconfig
# logging
CONFIG_LOG=y
CONFIG_LOG_MODE_IMMEDIATE=y
# CONFIG_NET_LOG=y
# CONFIG_NET_MGMT_EVENT_LOG_LEVEL_DBG=y
# CONFIG_NET_L2_WIFI_MGMT_LOG_LEVEL_DBG=y
# CONFIG_NET_DHCPV4_SERVER_LOG_LEVEL_DBG=y
# CONFIG_WIFI_LOG_LEVEL_DBG=y
# CONFIG_NET_DEBUG_MGMT_EVENT_STACK=y
# two options below are to log thread stack usage
CONFIG_INIT_STACKS=y
CONFIG_THREAD_STACK_INFO=y

# NVS
CONFIG_FLASH=y
CONFIG_FLASH_PAGE_LAYOUT=y
CONFIG_NVS=y
CONFIG_NVS_DATA_CRC=y

# Wi-Fi Configuration
CONFIG_WIFI=y

# ESP32 specific Wi-Fi Configuration
CONFIG_WIFI_ESP32=y
CONFIG_ESP32_WIFI_STA_AUTO_DHCPV4=y
CONFIG_ESP32_WIFI_AP_STA_MODE=y
CONFIG_WIFI_NM=y
CONFIG_WIFI_NM_MAX_MANAGED_INTERFACES=2


# Network Configuration
CONFIG_NET_CONFIG_AUTO_INIT=y
CONFIG_NET_CONNECTION_MANAGER=y
CONFIG_NET_DHCPV4=y
CONFIG_NET_DHCPV4_SERVER=y
CONFIG_NET_IF_MAX_IPV4_COUNT=2
CONFIG_NET_IPV4=y
CONFIG_NET_IPV6=n
CONFIG_NET_L2_ETHERNET=y
CONFIG_NET_L2_WIFI_MGMT=y
CONFIG_NET_MGMT=y
CONFIG_NET_MGMT_EVENT=y
CONFIG_NET_MGMT_EVENT_INFO=y
CONFIG_NET_MGMT_EVENT_QUEUE_SIZE=10
CONFIG_NET_MGMT_EVENT_STACK_SIZE=4096
CONFIG_NET_PKT_RX_COUNT=16
CONFIG_NET_PKT_TX_COUNT=16
CONFIG_NET_SOCKETS_SERVICE_STACK_SIZE=4096
CONFIG_NET_TCP=y
CONFIG_NETWORKING=y
```

## src/main.c
```c
#include <zephyr/kernel.h>
#include <zephyr/logging/log.h>
#include "app/nvs.h"
#include "app/config-settings.h"
#include "app/wifi.h"

LOG_MODULE_REGISTER(main, LOG_LEVEL_DBG);

int main(void)
{
    LOG_INF("Hello, World!");
    k_sleep(K_SECONDS(10));
    init_nvs();
    init_config_settings();
    init_wifi();
    k_sleep(K_SECONDS(10));
    LOG_DBG("Init complete.");

    enum error_e err;
    // test wifi logins
    // set_wifi_logins("Openserve-8B43", "RctVkh8VLh");
    // set_wifi_logins("wrong ssid", "RctVkh8VLh");
    set_wifi_logins("Openserve-8B43", "wrong password");
    enum logins_state_e state;
    // LOG_DBG("Testing wifi...");
    err = test_wifi_logins(&state);
    LOG_DBG("Test wifi logins result: %d.", state);
    // err = enable_wifi_station();
    if (err != E_SUCCESS) {
        LOG_ERR("Wifi test failed. Error %d.", err);
    } else {
        LOG_DBG("Wifi test completed successfully.");
    }
    while (true)
    {
        k_sleep(K_SECONDS(10));
    }

    // struct config_settings_t settings;
    // load_config_settings(&settings);

    // if (settings.wifi_ssid[0] == 0xFF)
    // {
    //     strcpy(settings.wifi_ssid, "my wifi");
    //     strcpy(settings.wifi_password, "my password");
    //     store_config_settings(&settings);
    //     LOG_INF("Reboot the device now.");
    // }
    // else
    // {
    //     LOG_INF("Wifi SSID: %s", settings.wifi_ssid);
    //     LOG_INF("Wifi password: %s", settings.wifi_password);
    // }

    // while (true)
    // {
    //     k_sleep(K_FOREVER);
    // }
}
```

## include/config-settings.h
```c
#ifndef CONFIG_SETTINGS_H
#define CONFIG_SETTINGS_H

#include "custom-error.h"
#include "constants.h"

#define RESET_WIFI_SSID_VALUE 0xFF
#define RESET_WIFI_PASSWORD_VALUE 0xFF

struct config_settings_t
{
    char wifi_ssid[WIFI_SSID_MAX_LENGTH + 1];
    char wifi_password[WIFI_PASSWORD_MAX_LENGTH + 1];
};

enum error_e init_config_settings(void);
void reset_config_settings(struct config_settings_t *c);
void load_config_settings(struct config_settings_t *c);
enum error_e store_config_settings(struct config_settings_t *c);

#endif
```

## include/constants.h
```c
#ifndef CONSTANTS_H
#define CONSTANTS_H

// constants below exclude the null char
#define WIFI_SSID_MAX_LENGTH 32
#define WIFI_PASSWORD_MIN_LENGTH 8
#define WIFI_PASSWORD_MAX_LENGTH 63

#endif
```

## include/custom-error.h
```c
#ifndef ERROR_H
#define ERROR_H

#define GENERAL_ERROR_BASE 0
#define CONFIG_SERVER_ERROR_BASE 100
#define WIFI_ERROR_BASE 200

enum error_e
{
    E_SUCCESS = GENERAL_ERROR_BASE,
    E_ERROR,  /* General error */
    E_PERM,   /* Operation not permitted */
    E_NOENT,  /* No such file or directory */
    E_SRCH,   /* No such process */
    E_INTR,   /* Interrupted system call */
    E_IO,     /* I/O error */
    E_NXIO,   /* No such device or address */
    E_2BIG,   /* Argument list too long */
    E_NOEXEC, /* Exec format error */
    E_BADF,   /* Bad file number */
    E_CHILD,  /* No child processes */
    E_AGAIN,  /* Try again */
    E_NOMEM,  /* Out of memory */
    E_ACCES,  /* Permission denied */
    E_FAULT,  /* Bad address */
    E_NOTBLK, /* Block device required */
    E_BUSY,   /* Device or resource busy */
    E_EXIST,  /* File exists */
    E_XDEV,   /* Cross-device link */
    E_NODEV,  /* No such device */
    E_NOTDIR, /* Not a directory */
    E_ISDIR,  /* Is a directory */
    E_INVAL,  /* Invalid argument */
    E_NFILE,  /* File table overflow */
    E_MFILE,  /* Too many open files */
    E_NOTTY,  /* Not a typewriter */
    E_TXTBSY, /* Text file busy */
    E_FBIG,   /* File too large */
    E_NOSPC,  /* No space left on device */
    E_SPIPE,  /* Illegal seek */
    E_ROFS,   /* Read-only file system */
    E_MLINK,  /* Too many links */
    E_PIPE,   /* Broken pipe */
    E_DOM,    /* Math argument out of domain of func */
    E_RANGE,  /* Math result not representable */

    // my own stuff

    E_NULL_PTR,
    E_ALREADY_DONE,
    E_IN_PROGRESS,

    // config server errors
    // CONFIG_SERVER_ERROR_BASE

    E_WIFI_LOGINS_NOT_SET,
    E_WIFI_LOGINS_INVALID,
};

#endif
```

## include/nvs-helpers.h
```c
#ifndef NVS_HELPERS_H
#define NVS_HELPERS_H

#include "custom-error.h"

enum nvs_key_e {
    NVS_KEY_CONFIG_SETTINGS = 1
};

enum error_e init_nvs(void);
struct nvs_fs* get_nvs_fs(void);


#endif
```

## include/string-helpers.h
```c
#ifndef STRING_HELPERS_H
#define STRING_HELPERS_H

#include <stdbool.h>
#include <stdlib.h>
#include <stdint.h>


bool is_printable_ascii_char(uint8_t byte);
bool is_printable_ascii_string(uint8_t *buffer, size_t buffer_len);


#endif
```

## include/wifi-helpers.h
```c
#ifndef WIFI_HELPERS_H
#define WIFI_HELPERS_H

#include <zephyr/kernel.h>
#include "custom-error.h"
#include "constants.h"

/**
 * Events:
 * 1. station enabled
 * 2. ap enabled
 * 3. logins tested
 * 4. logins valid
 */

enum wifi_station_state_e
{
    STATION_STATE_CONNECTED,
    STATION_STATE_CONNECTED_WITHOUT_IP,
    STATION_STATE_DISCONNECTED,
    STATION_STATE_CONNECTING,
    STATION_STATE_DISCONNECTING,
};

enum wifi_ap_state_e
{
    AP_STATE_ENABLED,
    AP_STATE_DISABLED,
    AP_STATE_ENABLING,
    AP_STATE_DISABLING,
};

enum logins_state_e
{
    NOT_SET,
    SET_AND_NOT_TESTED,
    SET_AND_INVALID,
    SET_AND_VALID,
};

struct wifi_state_t
{
    enum wifi_station_state_e station_state;
    enum wifi_ap_state_e ap_state;
    enum logins_state_e logins_state;
    bool power_saving_mode_enabled
};

void init_wifi(void);
void set_wifi_logins(char *ssid, char *password);
enum error_e enable_wifi_station(void);
enum error_e disable_wifi_station(void);
enum error_e enable_wifi_ap(void);
enum error_e disable_wifi_ap(void);
void get_wifi_state(struct wifi_state_t *s);

#endif
```

## src/config-settings.c
```c
/*
 * Configuration Management Module (config_store.c)
 * -----------------------------------------------------------------------------
 * This module manages the application's persistent configuration data 
 * (struct config_settings_t), ensuring thread safety and data integrity 
 * when interacting with Non-Volatile Storage (NVS).
 *
 * Design Principles:
 * 1. Single Source of Truth: The configuration is stored in one global, 
 *    static structure: 'config_settings'.
 * 2. Thread Safety: Access to 'config_settings' is protected by 'config_settings_mutex' 
 *    to prevent "torn reads" and race conditions.
 * 3. Minimal Flash Access: Configuration is read from NVS once at boot (config_init) 
 *    and saved only when modified (store_config_settings), minimizing flash wear.
 * 4. Usage Contract: Callers are not given access to config_settings. Threads 
 *    must create a local copy and use the following functions:
 *    - load_config_settings() for reading the active configuration (Safe Read).
 *    - store_config_settings() for validating and writing changes to RAM and Flash.
 *
 * NOTE: This implementation should use CONFIG_NVS_DATA_CRC=y in prj.conf 
 * to guarantee the integrity of the data payload in Flash.
 */

#include <zephyr/kernel.h>
#include <zephyr/fs/nvs.h>
#include "app/config-settings.h"
#include "app/nvs.h"
#include "app/string.h"

static struct config_settings_t config_settings = {0};
static struct k_mutex config_settings_mutex = {0};

/**
 * @brief Validates the Wi-Fi SSID and Password fields against basic rules.
 * 
 * @param c Pointer to the proposed configuration structure.
 * @return true if credentials are valid or correctly unspecified; false otherwise.
 */
static bool validate_wifi_ssid_and_password(struct config_settings_t *c)
{
    if (c == NULL)
    {
        return false;
    }
    // if both are unspecified, return true
    if (c->wifi_ssid[0] == RESET_WIFI_SSID_VALUE && c->wifi_password[0] == RESET_WIFI_PASSWORD_VALUE)
    {
        return true;
    }

    // if only one is given, return false
    if (c->wifi_ssid[0] == RESET_WIFI_SSID_VALUE || c->wifi_password[0] == RESET_WIFI_PASSWORD_VALUE)
    {
        return false;
    }

    // if ssid or password is not an ascii printable string, return false
    if (!is_printable_ascii_string(c->wifi_ssid, sizeof(c->wifi_ssid)))
    {
        return false;
    }
    if (!is_printable_ascii_string(c->wifi_password, sizeof(c->wifi_password)))
    {
        return false;
    }

    // if password is too short, return false
    // zero length means that no password is needed.
    size_t password_length = strlen(c->wifi_password);
    if (password_length != 0 && password_length < WIFI_PASSWORD_MIN_LENGTH)
    {
        return false;
    }
    return true;
}

/**
 * @brief Loads the config settings from flash into the main config settings.
 * 
 * @return E_SUCCESS or E_ERROR
 */
static enum error_e load_main_config_settings(void)
{
    struct nvs_fs *fs = get_nvs_fs();
    enum error_e err;

    k_mutex_lock(&config_settings_mutex, K_FOREVER);
    // try to read config settings
    ssize_t bytes_read = nvs_read(fs, NVS_KEY_CONFIG_SETTINGS, &config_settings, sizeof(struct config_settings_t));
    if (bytes_read == -ENOENT)
    {
        // key does not exist. create config settings
        reset_config_settings(&config_settings);
        nvs_write(fs, NVS_KEY_CONFIG_SETTINGS, &config_settings, sizeof(struct config_settings_t));
        err = E_SUCCESS;
    }
    else if (bytes_read != sizeof(struct config_settings_t))
    {
        // for some reason, the read failed
        reset_config_settings(&config_settings);
        err = E_ERROR;
    } else {
        err = E_SUCCESS;
    }

    k_mutex_unlock(&config_settings_mutex);
    return err;
}

/**
 * @brief Initializes config settings module.
 * Call this function before using anything else from this module.
 * Initialize NVS before calling this function.
 * 
 * @return E_SUCCESS or E_ERROR
 */
enum error_e init_config_settings(void)
{
    k_mutex_init(&config_settings_mutex);
    enum error_e err = load_main_config_settings();
    return err;
}

/**
 * @brief Sets all config settings to their reset state.
 * 
 * @param c Pointer to the config settings struct.
 */
void reset_config_settings(struct config_settings_t *c)
{
    if (c == NULL)
    {
        return;
    }
    memset(c->wifi_ssid, 0, sizeof(c->wifi_ssid));
    c->wifi_ssid[0] = RESET_WIFI_SSID_VALUE;
    memset(c->wifi_password, 0, sizeof(c->wifi_password));
    c->wifi_password[0] = RESET_WIFI_PASSWORD_VALUE;
}

/**
 * @brief Copies the main config settings to the provided config settings.
 * 
 * @param c Pointer to the config settings struct.
 */
void load_config_settings(struct config_settings_t *c)
{
    if (c == NULL)
    {
        return;
    }
    k_mutex_lock(&config_settings_mutex, K_FOREVER);
    memcpy(c, &config_settings, sizeof(struct config_settings_t));
    k_mutex_unlock(&config_settings_mutex);
}

/**
 * @brief Stores the provided config settings in NVS provided that they are valid.
 * 
 * @param c Pointer to the config settings struct.
 * @return E_NULL_PTR if c is NULL. 
 * @return E_INVAL if c is invalid.
 * @return E_SUCCESS if store was successful.
 * @return E_ERROR if an error occured.
 */
enum error_e store_config_settings(struct config_settings_t *c)
{
    if (c == NULL)
    {
        return E_NULL_PTR;
    }

    bool config_settings_valid = validate_wifi_ssid_and_password(c);
    if (!config_settings_valid)
    {
        return E_INVAL;
    }
    struct nvs_fs *fs = get_nvs_fs();
    k_mutex_lock(&config_settings_mutex, K_FOREVER);
    ssize_t bytes_written = nvs_write(fs, NVS_KEY_CONFIG_SETTINGS, c, sizeof(struct config_settings_t));
    enum error_e err = bytes_written == sizeof(struct config_settings_t) || bytes_written == 0 ? E_SUCCESS : E_ERROR;
    if (err == E_SUCCESS)
    {
        memcpy(&config_settings, c, sizeof(struct config_settings_t));
    }
    k_mutex_unlock(&config_settings_mutex);
    return err;
}
```

## src/nvs-helpers.c
```c
#include <zephyr/device.h>
#include <zephyr/drivers/flash.h>
#include <zephyr/storage/flash_map.h>
#include <zephyr/fs/nvs.h>
#include <zephyr/logging/log.h>
#include "custom-error.h"

LOG_MODULE_REGISTER(nvs_helpers, LOG_LEVEL_WRN);

#define NVS_PARTITION storage_partition
#define NVS_PARTITION_DEVICE FIXED_PARTITION_DEVICE(NVS_PARTITION)
#define NVS_PARTITION_OFFSET FIXED_PARTITION_OFFSET(NVS_PARTITION)

static struct nvs_fs fs = {0};
static struct flash_pages_info info = {0};

/*
 * Initialize NVS.
 *
 * Code was adapted from zephyr/samples/subsys/nvs.
 */
enum error_e init_nvs()
{

    int err;

    fs.flash_device = NVS_PARTITION_DEVICE;
    if (!device_is_ready(fs.flash_device))
    {
        LOG_ERR("Flash device was not ready.");
        return E_ERROR;
    }
    fs.offset = NVS_PARTITION_OFFSET;
    err = flash_get_page_info_by_offs(fs.flash_device, fs.offset, &info);
    if (err)
    {
        LOG_ERR("Page of the offset doesn't exist.");
        return E_ERROR;
    }
    fs.sector_size = info.size;
    fs.sector_count = 3U;  // TODO: figure out the best sector count size

    err = nvs_mount(&fs);
    if (err)
    {
        LOG_ERR("Failed to mount NVS file system.");
        return E_ERROR;
    }
}

struct nvs_fs* get_nvs_fs(void) {
    return &fs;
}
```

## src/nvs.c
```c
#include <zephyr/device.h>
#include <zephyr/drivers/flash.h>
#include <zephyr/storage/flash_map.h>
#include <zephyr/fs/nvs.h>
#include <zephyr/logging/log.h>
#include "app/error.h"

LOG_MODULE_REGISTER(nvs_helpers, LOG_LEVEL_WRN);

#define NVS_PARTITION storage_partition
#define NVS_PARTITION_DEVICE FIXED_PARTITION_DEVICE(NVS_PARTITION)
#define NVS_PARTITION_OFFSET FIXED_PARTITION_OFFSET(NVS_PARTITION)

static struct nvs_fs fs = {0};
static struct flash_pages_info info = {0};

/*
 * Initialize NVS.
 *
 * Code was adapted from zephyr/samples/subsys/nvs.
 */
enum error_e init_nvs()
{

    int err;

    fs.flash_device = NVS_PARTITION_DEVICE;
    if (!device_is_ready(fs.flash_device))
    {
        LOG_ERR("Flash device was not ready.");
        return E_ERROR;
    }
    fs.offset = NVS_PARTITION_OFFSET;
    err = flash_get_page_info_by_offs(fs.flash_device, fs.offset, &info);
    if (err)
    {
        LOG_ERR("Page of the offset doesn't exist.");
        return E_ERROR;
    }
    fs.sector_size = info.size;
    fs.sector_count = 3U;  // TODO: figure out the best sector count size

    err = nvs_mount(&fs);
    if (err)
    {
        LOG_ERR("Failed to mount NVS file system.");
        return E_ERROR;
    }
    return E_SUCCESS;
}

struct nvs_fs* get_nvs_fs(void) {
    return &fs;
}
```

## src/string-helpers.c
```c
#include <stdbool.h>
#include <stdlib.h>
#include <stdint.h>


bool is_printable_ascii_char(uint8_t byte) {
    return byte >= 32 && byte <= 126;
}


bool is_printable_ascii_string(uint8_t* buffer, size_t buffer_len) {
    if (buffer == NULL) {
        return false;
    }

    for (size_t i = 0; i < buffer_len; i++) {
        if (buffer[i] == '\0') {
            return true;
        }
        if (!is_printable_ascii_char(buffer[i])) {
            return false;
        }
    }
    // no null-terminator so return false
    return false;
}
```

## src/temperature-logger.c
```c
#include <stdint.h>
#include <sys/types.h>
#include <stdlib.h>
#include <zephyr/kernel.h>
#include <zephyr/device.h>
#include <zephyr/devicetree.h>
#include <zephyr/fs/nvs.h>
#include <zephyr/drivers/sensor.h>
#include <zephyr/logging/log.h>
#include "app/error.h"
#include "app/temperature-logger.h"
#include "app/nvs.h"
#include "app/lock.h"
#include "app/test.h"

LOG_MODULE_REGISTER(temp_log, LOG_LEVEL_DBG);

struct temperature_logger_data_t
{
    struct temperature_list_t temperature_list;
    struct temperature_list_t scratch_temperature_list; /* used when operating on nvs data */
    struct device *temperature_sensor;
    struct k_work_delayable sampling_task;
};

static void perform_sampling_task(struct k_work *work);

static struct temperature_logger_data_t t_data = {
    .temperature_list.lock = Z_MUTEX_INITIALIZER(t_data.temperature_list.lock),
    .scratch_temperature_list.lock = Z_MUTEX_INITIALIZER(t_data.scratch_temperature_list.lock),
    .temperature_sensor = DEVICE_DT_GET_ANY(maxim_ds18b20),
    .sampling_task = Z_WORK_DELAYABLE_INITIALIZER(perform_sampling_task)};


/**
 * @brief Initializes the temperature logging subsystem.
 * * This includes checking device readiness and scheduling the first sampling task 
 * via the system workqueue. This is the main exposed entry point.
 * * @retval E_SUCCESS Successful initialization.
 * @retval E_ERROR Sensor device not found or not ready.
 */
enum error_e init_temperature_logger(void)
{
    if (t_data.temperature_sensor == NULL)
    {
        LOG_ERR("Temperature sensor device was not found.");
        return E_ERROR;
    }

    if (!device_is_ready(t_data.temperature_sensor))
    {
        LOG_ERR("Temperature sensor device is not ready.");
        return E_ERROR;
    }

    k_work_reschedule(&t_data.sampling_task, K_NO_WAIT);
    return E_SUCCESS;
}

/**
 * @brief Resets a temperature list, zeroing out the data array and setting length to 0.
 * * ASSUMPTION: The caller (perform_sampling_task) MUST hold the list's lock before calling.
 * * @param t Pointer to the temperature list structure to reset.
 * @retval E_SUCCESS List successfully reset.
 * @retval E_NULL_PTR If 't' is NULL.
 */
EXPOSE_FOR_TESTING enum error_e reset_temperature_list(struct temperature_list_t *t)
{
    if (t == NULL)
    {
        LOG_ERR(GENERIC_NULL_PTR_ERROR_MESSAGE);
        return E_NULL_PTR;
    }
    memset(t, 0, offsetof(struct temperature_list_t, lock));
    return E_SUCCESS;
}

/**
 * @brief Reads the temperature list from NVS flash storage into the provided list structure.
 * * If the key does not exist, the list is reset and a zeroed structure is written.
 * ASSUMPTION: The caller MUST hold the list's lock before calling.
 * * @param t Pointer to the list structure where data will be loaded.
 * @retval E_SUCCESS Data successfully loaded or key created.
 * @retval E_ERROR Read failed due to NVS error or size mismatch.
 * @retval E_NULL_PTR If 't' is NULL.
 */
EXPOSE_FOR_TESTING enum error_e load_temperature_list(struct temperature_list_t *t)
{
    if (t == NULL)
    {
        LOG_ERR(GENERIC_NULL_PTR_ERROR_MESSAGE);
        return E_NULL_PTR;
    }

    struct nvs_fs *fs = get_nvs_fs();
    enum error_e err;

    // try to read
    ssize_t bytes_read = nvs_read(fs, NVS_KEY_TEMPERATURE_DATA, t, offsetof(struct temperature_list_t, lock));
    if (bytes_read == -ENOENT)
    {
        // key does not exist. create key
        reset_temperature_list(t);
        nvs_write(fs, NVS_KEY_TEMPERATURE_DATA, t, offsetof(struct temperature_list_t, lock));
        err = E_SUCCESS;
    }
    else if (bytes_read != offsetof(struct temperature_list_t, lock))
    {
        // for some reason, the read failed
        LOG_ERR("Failed to load temperature list from NVS. Expected to read %d bytes. Read %d bytes.", (int)offsetof(struct temperature_list_t, lock), (int)bytes_read);
        err = E_ERROR;
    }
    else
    {
        err = E_SUCCESS;
    }
    return err;
}

/**
 * @brief Writes the temperature list to NVS flash storage.
 * * ASSUMPTION: The caller MUST hold the list's lock before calling.
 * * @param t Pointer to the list structure whose data will be stored.
 * @retval E_SUCCESS Data successfully written.
 * @retval E_ERROR Write failed due to NVS error.
 * @retval E_NULL_PTR If 't' is NULL.
 */
EXPOSE_FOR_TESTING enum error_e store_temperature_list(struct temperature_list_t *t)
{
    if (t == NULL)
    {
        LOG_ERR(GENERIC_NULL_PTR_ERROR_MESSAGE);
        return E_NULL_PTR;
    }

    struct nvs_fs *fs = get_nvs_fs();
    ssize_t bytes_written = nvs_write(fs, NVS_KEY_TEMPERATURE_DATA, t, offsetof(struct temperature_list_t, lock));
    enum error_e err = bytes_written == offsetof(struct temperature_list_t, lock) || bytes_written == 0 ? E_SUCCESS : E_ERROR;
    if (err != E_SUCCESS)
    {
        LOG_ERR("Failed to write temperature list to NVS. Expected to write %d bytes or 0 bytes. Wrote %d bytes.", (int)offsetof(struct temperature_list_t, lock), (int)bytes_written);
    }
    return err;
}

/**
 * @brief Converts a standard sensor_value struct (val1=whole, val2=micro) into 
 * the 4-bit fixed-point temperature_t format.
 * * @param v The sensor_value struct containing raw temperature readings.
 * @return temperature_t The temperature value scaled by 16 (4 fractional bits).
 */
EXPOSE_FOR_TESTING temperature_t sensor_value_to_temperature(struct sensor_value v)
{
    float whole = (float)v.val1;
    float fractional = (float)v.val2 / 1000000.0f;
    float float_temperature = whole + fractional;
    temperature_t temperature = (temperature_t)(float_temperature * 16);
    return temperature;
}

/**
 * @brief Fetches data from the sensor and creates a single temperature sample.
 * * Reads the current sensor value and combines it with the current system uptime (in minutes).
 * * @param t Pointer to the temperature_sample_t structure to fill.
 * @retval E_SUCCESS Sample successfully acquired and prepared.
 * @retval E_ERROR Sensor fetching/reading failed.
 * @retval E_NULL_PTR If 't' is NULL.
 */
EXPOSE_FOR_TESTING enum error_e get_temperature_sample(struct temperature_sample_t *t)
{
    if (t == NULL)
    {
        LOG_ERR(GENERIC_NULL_PTR_ERROR_MESSAGE);
        return E_NULL_PTR;
    }
    struct sensor_value temperature;
    int result = sensor_sample_fetch(t_data.temperature_sensor);
    t->uptime = get_uptime_in_minutes();
    if (result != 0)
    {
        LOG_ERR("Failed to request temperature sample. Error %d.", result);
        return E_ERROR;
    }
    result = sensor_channel_get(t_data.temperature_sensor, SENSOR_CHAN_AMBIENT_TEMP, &temperature);
    if (result != 0)
    {
        LOG_ERR("Failed to read temperature sample. Error %d.", result);
        return E_ERROR;
    }
    t->temperature = sensor_value_to_temperature(temperature);
    return E_SUCCESS;
}

/**
 * @brief Appends a single temperature sample to the end of a list.
 * * ASSUMPTION: The caller MUST hold the list's lock before calling.
 * * @param list Pointer to the destination list.
 * @param sample The temperature sample to append (copied by value).
 * @retval E_SUCCESS Sample successfully appended.
 * @retval E_NOBUFS The list is already full (length == CONFIG_TEMPERATURE_LOGGER_BUFFER_SIZE).
 * @retval E_NULL_PTR If 'list' is NULL.
 */
EXPOSE_FOR_TESTING enum error_e append_temperature_sample(struct temperature_list_t *list, struct temperature_sample_t sample)
{
    if (list == NULL)
    {
        LOG_ERR(GENERIC_NULL_PTR_ERROR_MESSAGE);
        return E_NULL_PTR;
    }
    if (list->length == CONFIG_TEMPERATURE_LOGGER_BUFFER_SIZE)
    {
        return E_NOBUFS;
    }
    list->data[list->length] = sample;
    list->length++;
    return E_SUCCESS;
}

/**
 * @brief Performs linear interpolation between two samples (t1 and t2) at a given uptime.
 * * Calculates the synthesized temperature and stores it in the result structure.
 * * @param t1 Pointer to the first sample.
 * @param t2 Pointer to the second sample.
 * @param result Pointer to the structure where the synthesized temperature will be stored. 
 * The result->uptime field MUST be set by the caller before calling.
 * @retval E_SUCCESS Interpolation successful.
 * @retval E_NULL_PTR If t1, t2, or result is NULL.
 */
EXPOSE_FOR_TESTING enum error_e interpolate(struct temperature_sample_t *t1, struct temperature_sample_t *t2, struct temperature_sample_t *result)
{
    if (t1 == NULL || t2 == NULL || result == NULL)
    {
        LOG_ERR(GENERIC_NULL_PTR_ERROR_MESSAGE);
        return E_NULL_PTR;
    }
    if (t1->uptime == t2->uptime)
    {
        result->temperature = (t1->temperature + t2->temperature) / 2;
        return E_SUCCESS;
    }
    struct temperature_sample_t *earlier, *later;
    if (t1->uptime < t2->uptime)
    {
        earlier = t1;
        later = t2;
    }
    else
    {
        earlier = t2;
        later = t1;
    }

    int32_t d_temp = (int32_t)t2->temperature - (int32_t)t1->temperature;
    uint32_t d_uptime = (uint32_t)(later->uptime - earlier->uptime);
    uint32_t d_uptime_to_result = (uint32_t)(result->uptime - earlier->uptime);
    int16_t d_temp_to_result = (int16_t)((float)d_temp * (float)d_uptime_to_result / (float)d_uptime);
    result->temperature = (temperature_t)(earlier->temperature + d_temp_to_result);
    return E_SUCCESS;
}

/**
 * @brief Initializes the merge iterator for two source lists.
 * * Sets the initial current list and indices based on which list has the earliest sample.
 * ASSUMPTION: The caller MUST hold the lists' locks before calling.
 * * @param m Pointer to the merge_iterator_t structure to initialize.
 * @param src1 Pointer to the first source list.
 * @param src2 Pointer to the second source list.
 * @retval E_SUCCESS Initialization complete.
 * @retval E_NULL_PTR If any input pointer is NULL.
 */
EXPOSE_FOR_TESTING enum error_e init_merge_iterator(struct merge_iterator_t *m, struct temperature_list_t *src1, struct temperature_list_t *src2)
{
    if (m == NULL || src1 == NULL || src2 == NULL)
    {
        LOG_ERR(GENERIC_NULL_PTR_ERROR_MESSAGE);
        return E_NULL_PTR;
    }
    m->src1 = src1;
    m->src2 = src2;
    m->current_index = 0;

    // if both lists have length zero
    // will return E_END_OF_ITER forever
    if (src1->length == 0 && src2->length == 0)
    {
        m->current_list = NULL;
        return;
    }
    else if (src1->length == 0)
    {
        m->current_list = src2;
        m->next_src1_index = 0;
        m->next_src2_index = 1;
        return;
    }
    else if (src2->length == 0)
    {
        m->current_list = src1;
        m->next_src1_index = 1;
        m->next_src2_index = 0;
        return;
    }
    // current starts at the earliest datapoint
    else if (src1->data[0].uptime < src2->data[0].uptime)
    {
        m->current_list = src1;
        m->next_src1_index = 1;
        m->next_src2_index = 0;
    }
    else
    {
        m->current_list = src2;
        m->next_src1_index = 0;
        m->next_src2_index = 1;
    }
    return E_SUCCESS;
}

/**
 * @brief Advances the merge iterator and returns a pointer to the chronologically next sample.
 * * @param m Pointer to the merge iterator state.
 * @param sample Output pointer (pointer to a pointer) that will be set to the address of the next sample.
 * @retval E_SUCCESS Sample pointer successfully returned and iterator advanced.
 * @retval E_END_OF_ITER No more samples left in either source list.
 * @retval E_NULL_PTR If 'm' or 'sample' is NULL.
 */
EXPOSE_FOR_TESTING enum error_e merge_iterate(struct merge_iterator_t *m, struct temperature_sample_t **sample)
{

    if (m == NULL || sample == NULL)
    {
        LOG_ERR(GENERIC_NULL_PTR_ERROR_MESSAGE);
        return E_NULL_PTR;
    }
    if (m->current_list == NULL)
    {
        return E_END_OF_ITER;
    }
    else
    {
        *sample = &(m->current_list->data[m->current_index]);
    }

    bool at_src1_end = m->next_src1_index == m->src1->length;
    bool at_src2_end = m->next_src2_index == m->src2->length;

    // if at the end of both lists
    if (at_src1_end && at_src2_end)
    {
        // set to null to return E_END_OF_ITER on next call
        m->current_list = NULL;
    }
    else if (at_src1_end)
    {
        // forced to progress src2
        m->current_list = m->src2;
        m->current_index = m->next_src2_index;
        m->next_src2_index++;
    }
    else if (at_src2_end)
    {
        // forced to progress src1
        m->current_list = m->src1;
        m->current_index = m->next_src1_index;
        m->next_src1_index++;
    }
    else if (m->src1->data[m->next_src1_index].uptime < m->src2->data[m->next_src2_index].uptime)
    {
        m->current_list = m->src1;
        m->current_index = m->next_src1_index;
        m->next_src1_index++;
    }
    else
    {
        m->current_list = m->src2;
        m->current_index = m->next_src2_index;
        m->next_src2_index++;
    }
    return E_SUCCESS;
}

/**
 * @brief Merges two source lists chronologically into a destination list without decimation.
 * * Used when the total number of input elements is less than or equal to the capacity.
 * ASSUMPTION: The caller MUST hold the lists' locks before calling.
 * * @param src1 Pointer to the first source list.
 * @param src2 Pointer to the second source list.
 * @param dest Pointer to the destination list where the full, merged set is copied.
 * @retval E_SUCCESS Merge successful.
 * @retval E_ERROR An error occurred during iteration.
 * @retval E_NULL_PTR If any input pointer is NULL.
 */
EXPOSE_FOR_TESTING enum error_e merge_without_decimation(struct temperature_list_t *src1, struct temperature_list_t *src2, struct temperature_list_t *dest)
{
    if (src1 == NULL || src2 == NULL || dest == NULL)
    {
        LOG_ERR(GENERIC_NULL_PTR_ERROR_MESSAGE);
        return E_NULL_PTR;
    }

    struct temperature_sample_t merged[CONFIG_TEMPERATURE_LOGGER_BUFFER_SIZE];
    struct merge_iterator_t iterator;
    struct temperature_sample_t *sample;
    size_t index = 0;
    enum error_e err;

    init_merge_iterator(&iterator, src1, src2);
    while (true)
    {
        err = merge_iterate(&iterator, &sample);
        if (err == E_END_OF_ITER)
        {
            err = E_SUCCESS;
            memmove(dest->data, merged, sizeof(struct temperature_sample_t) * index);
            dest->length = index;
            return E_SUCCESS;
        }
        else if (err != E_SUCCESS)
        {
            LOG_ERR("Merging without interpolation failed. Error %d.", err);
            return E_ERROR;
        }
        merged[index] = *sample;
        index++;
    }
}

/**
 * @brief Merges two source lists into a destination list using uniform interpolation (decimation).
 * * Used when the total number of input elements exceeds the list capacity.
 * The result is a list of CONFIG_TEMPERATURE_LOGGER_BUFFER_SIZE samples uniformly spaced by time.
 * ASSUMPTION: The caller MUST hold the lists' locks before calling.
 * * @param src1 Pointer to the first source list.
 * @param src2 Pointer to the second source list.
 * @param dest Pointer to the destination list (output size = CONFIG_TEMPERATURE_LOGGER_BUFFER_SIZE).
 * @retval E_SUCCESS Merge successful.
 * @retval E_ERROR An error occurred during iteration or interpolation.
 * @retval E_NULL_PTR If any input pointer is NULL.
 */
EXPOSE_FOR_TESTING enum error_e merge_with_decimation(struct temperature_list_t *src1, struct temperature_list_t *src2, struct temperature_list_t *dest)
{
    if (src1 == NULL || src2 == NULL || dest == NULL)
    {
        LOG_ERR(GENERIC_NULL_PTR_ERROR_MESSAGE);
        return E_NULL_PTR;
    }
    struct temperature_sample_t merged[CONFIG_TEMPERATURE_LOGGER_BUFFER_SIZE];

    // time
    sys_minutes_t start_uptime = MIN(src1->data[0].uptime, src2->data[0].uptime);
    sys_minutes_t end_uptime = MAX(src1->data[src1->length - 1].uptime, src2->data[src2->length - 1].uptime);
    sys_minutes_t merge_duration = end_uptime - start_uptime;
    sys_minutes_t sample_base_period = merge_duration / (CONFIG_TEMPERATURE_LOGGER_BUFFER_SIZE - 1);
    sys_minutes_t long_periods_needed = merge_duration % (CONFIG_TEMPERATURE_LOGGER_BUFFER_SIZE - 1);

    struct temperature_sample_t *current = NULL, *prev = NULL;
    struct merge_iterator_t iterator;
    init_merge_iterator(&iterator, src1, src2);
    merge_iterate(&iterator, &prev);
    merge_iterate(&iterator, &current);

    size_t merge_index = 0;
    sys_minutes_t merge_uptime = start_uptime;
    enum error_e err = E_SUCCESS;

    while (merge_index < CONFIG_TEMPERATURE_LOGGER_BUFFER_SIZE)
    {
        // if time is between the two points, perform an interpolation
        // otherwise, shift the current and prev samples
        if (merge_uptime >= prev->uptime && merge_uptime <= current->uptime)
        {
            merged[merge_index].uptime = merge_uptime;
            err = interpolate(prev, current, &merged[merge_index]);
            if (err != E_SUCCESS)
            {
                return err;
            }
            merge_index++;
            merge_uptime += sample_base_period + (merge_index <= long_periods_needed ? 1 : 0);
        }
        else
        {
            prev = current;
            err = merge_iterate(&iterator, &current);
            if (err != E_SUCCESS)
            {
                LOG_ERR("Merge with interpolation failed. Error %d.", err);
                return E_ERROR;
            }
        }
    }

    // copy the result to dest
    memmove(dest->data, merged, sizeof(struct temperature_sample_t) * CONFIG_TEMPERATURE_LOGGER_BUFFER_SIZE);
    dest->length = CONFIG_TEMPERATURE_LOGGER_BUFFER_SIZE;
    return E_SUCCESS;
}

/**
 * @brief Dispatcher function that selects between chronological merge and decimation/interpolation.
 * * If total length <= capacity, it calls merge_without_decimation.
 * Otherwise, it calls merge_with_decimation.
 * ASSUMPTION: The caller MUST hold the lists' locks before calling.
 * * @param src1 Pointer to the first source list.
 * @param src2 Pointer to the second source list.
 * @param dest Pointer to the destination list.
 * @retval E_SUCCESS Merge successful.
 * @retval E_NULL_PTR If any input pointer is NULL.
 * @retval E_ERROR Propagated error from helper functions.
 */
EXPOSE_FOR_TESTING enum error_e merge_temperature_lists(struct temperature_list_t *src1, struct temperature_list_t *src2, struct temperature_list_t *dest)
{
    if (src1 == NULL || src2 == NULL || dest == NULL)
    {
        return E_NULL_PTR;
    }

    enum error_e err;
    if (src1->length + src2->length <= CONFIG_TEMPERATURE_LOGGER_BUFFER_SIZE)
    {
        err = merge_without_decimation(src1, src2, dest);
    }
    else
    {
        err = merge_with_decimation(src1, src2, dest);
    }
    return err;
}

static bool temperature_list_is_full(struct temperature_list_t *t)
{
    return t != NULL && t->length == CONFIG_TEMPERATURE_LOGGER_BUFFER_SIZE;
}


/**
 * @brief The handler function executed by the k_work_delayable structure.
 * * This is the central synchronization point. It acquires the locks, checks if the 
 * RAM list is full, performs the merge/store cycle if needed, takes a new sample, 
 * appends it, and reschedules itself.
 * * Synchronization: Acquires DOUBLE_LOCK on t_data.temperature_list and 
 * t_data.scratch_temperature_list for the entire execution.
 * * @param work Pointer to the k_work structure (unused but required).
 */
static void perform_sampling_task(struct k_work *work)
{
    LOG_DBG("Performing sampling task");
    DOUBLE_LOCK(&t_data.temperature_list.lock, &t_data.scratch_temperature_list.lock, K_FOREVER);

    enum error_e err;
    // if RAM list is not full, sample the temperature
    // if the RAM list is full
    // read the NVS list, merge the two lists, store the result in NVS, clear the RAM list, sample the temperature

    if (temperature_list_is_full(&t_data.temperature_list))
    {
        err = load_temperature_list(&t_data.scratch_temperature_list);
        if (err != E_SUCCESS)
        {
            goto reschedule;
        }
        err = merge_temperature_lists(&t_data.temperature_list, &t_data.scratch_temperature_list, &t_data.scratch_temperature_list);
        if (err != E_SUCCESS)
        {
            goto reschedule;
        }
        err = store_temperature_list(&t_data.scratch_temperature_list);
        if (err != E_SUCCESS)
        {
            goto reschedule;
        }
        err = reset_temperature_list(&t_data.temperature_list);
        if (err != E_SUCCESS)
        {
            goto reschedule;
        }
    }

    struct temperature_sample_t sample;
    err = get_temperature_sample(&sample);
    if (err != E_SUCCESS)
    {
        goto reschedule;
    }
    err = append_temperature_sample(&t_data.temperature_list, sample);
reschedule:
    if (err != E_SUCCESS)
    {
        LOG_ERR("Failed to complete sampling task. Error %d.", err);
    }
    k_work_reschedule(&t_data.sampling_task, K_SECONDS(30));
    DOUBLE_UNLOCK(&t_data.temperature_list.lock, &t_data.scratch_temperature_list.lock);
}
```

## src/time.c
```c
#include <stdint.h>
#include <zephyr/kernel.h>
#include "app/time.h"

sys_minutes_t get_uptime_in_minutes() {
    return (sys_minutes_t)(k_uptime_get() / 1000 / 60);
}
```
